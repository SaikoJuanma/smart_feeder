## app/tests/integration/system/testcase.yaml
```yaml
tests:
  smart_feeder.integration.system:
    platform_allow: native_sim
    tags: smart_feeder integration
    harness: ztest
```

## app/tests/unit/check_health/testcase.yaml
```yaml
tests:
  smart_feeder.unit.check_health:
    platform_allow: native_sim
    tags: smart_feeder unit check_health
    harness: ztest
```

## app/tests/unit/communication/testcase.yaml
```yaml
tests:
  smart_feeder.unit.communication:
    platform_allow: native_sim
    tags: smart_feeder unit communication
    harness: ztest
```

## app/tests/unit/configuration/testcase.yaml
```yaml
tests:
  smart_feeder.unit.configuration:
    platform_allow: native_sim
    tags: smart_feeder unit configuration
    harness: ztest
```

## app/tests/unit/init/testcase.yaml
```yaml
tests:
  smart_feeder.unit.init:
    platform_allow: native_sim
    tags: smart_feeder unit init
    harness: ztest
```

## app/tests/unit/motor_control/testcase.yaml
```yaml
tests:
  smart_feeder.unit.motor_control:
    platform_allow: native_sim
    tags: smart_feeder unit motor_control
    harness: ztest
```

## app/tests/unit/shell_commands/testcase.yaml
```yaml
tests:
  smart_feeder.unit.shell_commands:
    platform_allow: native_sim
    tags: smart_feeder unit shell_commands
    harness: ztest
```

## app/tests/unit/watchdog/testcase.yaml
```yaml
tests:
  smart_feeder.unit.watchdog:
    platform_allow: native_sim
    tags: smart_feeder unit watchdog
    harness: ztest
```
