## CMakeLists.txt
```
cmake_minimum_required(VERSION 3.20.0)

find_package(Zephyr REQUIRED HINTS $ENV{ZEPHYR_BASE})
project(smart_feeder_integration_system)

target_sources(app PRIVATE
  src/test_system.c
  ../../../src/shell_commands.c
  ../../../src/init.c
  ../../../src/configuration.c
  ../../../src/motor_control.c
  ../../../src/check_health.c
)

target_include_directories(app PRIVATE
  ${CMAKE_CURRENT_LIST_DIR}/../../../include
)

target_compile_definitions(app PRIVATE SMART_FEEDER_UNIT_TEST=1)
```

## prj.conf
```kconfig
CONFIG_ZTEST=y
CONFIG_ZBUS=y
CONFIG_LOG=y
CONFIG_LOG_DEFAULT_LEVEL=3
CONFIG_SHELL=y
CONFIG_SHELL_BACKEND_DUMMY=y
CONFIG_SHELL_BACKEND_SERIAL=n
CONFIG_SHELL_LOG_BACKEND=n
CONFIG_FLASH=y
CONFIG_FLASH_MAP=y
CONFIG_NVS=y
CONFIG_NVS_LOG_LEVEL_DBG=y
CONFIG_REBOOT=y
CONFIG_WATCHDOG=y
```

## src/test_system.c
```c
#include <zephyr/kernel.h>
#include <zephyr/ztest.h>
#include "init.h"
#include "motor_control.h"
#include "configuration.h"
#include "check_health.h"
#include "watchdog.h"
#include "communication.h"

ZTEST(smart_feeder_integration, test_system_threads)
{
    int ret = init_nvs();
    zassert_equal(ret, 0, "NVS initialization failed");

    processes_init();

    start_motor_control_thread();
    start_check_health_thread();
    start_comm_thread();

    for (int i = 0; i < 11; i++) {
        k_msleep(100);
        watchdog_feed();
    }

    watchdog_disable();

    zassert_true(k_uptime_get() > 0, "System should be running");
    zassert_true(is_system_healthy(), "System reported unhealthy state");

#ifdef SMART_FEEDER_UNIT_TEST
    stop_motor_control_thread();
    stop_check_health_thread();
    stop_comm_thread();
#endif
}

ZTEST_SUITE(smart_feeder_integration, NULL, NULL, NULL, NULL, NULL);
```
